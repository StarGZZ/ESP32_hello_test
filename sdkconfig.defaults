## sdkconfig.defaults
```kconfig
CONFIG_IDF_TARGET="esp32s3"

# 16MB Flash, QIO, 80MHz
CONFIG_ESPTOOLPY_FLASHSIZE_16MB=y
CONFIG_ESPTOOLPY_FLASHMODE_QIO=y
CONFIG_ESPTOOLPY_FLASHFREQ_80M=y

# Octal PSRAM, 80MHz
CONFIG_SPIRAM=y
CONFIG_SPIRAM_MODE_OCT=y
CONFIG_SPIRAM_SPEED_80M=y

# CPU 240MHz
CONFIG_ESP_DEFAULT_CPU_FREQ_MHZ_240=y

# Console via USB-Serial-JTAG
CONFIG_ESP_CONSOLE_USB_SERIAL_JTAG=y
```
